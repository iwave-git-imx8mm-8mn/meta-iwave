## conf/machine/imx8mm-iwg34m.conf
```bitbake
#@TYPE: Machine
#@NAME: iWave iW-RainboW-G34M-i.MX8M Mini SODIMM Development Kit
#@DESCRIPTION: Machine configuration for iWave iW-RainboW-G34M-i.MX8M Mini SODIMM Board
#@MAINTAINER: iWave Systems Technologies Pvt. Ltd.

MACHINEOVERRIDES =. "mx8:mx8m:mx8mm:"

require conf/machine/include/imx-base.inc
require conf/machine/include/tune-cortexa53.inc

MACHINE_FEATURES += " pci wifi bluetooth optee qca9377 bcm43455 bcm4356 bcm4359"

PREFERRED_PROVIDER_virtual/bootloader_mx8 = "u-boot-iwg"
PREFERRED_PROVIDER_virtual/kernel_mx8 = "linux-iwg"

# Device tree for i.MX8MM IWG34M
KERNEL_DEVICETREE = "freescale/imx8mm-iwg34d.dtb"

UBOOT_CONFIG ??= "sd"
UBOOT_CONFIG[sd] = "imx8mm_iwg34m_defconfig,sdcard"
SPL_BINARY = "spl/u-boot-spl.bin"

# Set DDR FIRMWARE
DDR_FIRMWARE_NAME = "lpddr4_pmu_train_1d_imem.bin lpddr4_pmu_train_1d_dmem.bin lpddr4_pmu_train_2d_imem.bin lpddr4_pmu_train_2d_dmem.bin"

WKS_FILE_DEPENDS_mx8 += "e2fsprogs-native"

# Set u-boot DTB
UBOOT_DTB_NAME = "imx8mm-iwg34m.dtb"

IMAGE_INSTALL_append = " iwtest obexftp dhcpcd dnsmasq "

# Set imx-mkimage boot target
IMXBOOT_TARGETS = "flash_iwg34m"

SERIAL_CONSOLES = "115200;ttymxc3"

IMAGE_BOOTLOADER = "imx-boot"

LOADADDR = ""
IMX_BOOT_SEEK = "33"
```

## conf/machine/imx8mn-iwg37m-2gb.conf
```bitbake
#@TYPE: Machine
#@NAME: iWave iW-RainboW-G37M-i.MX8M Nano SODIMM Development Kit
#@DESCRIPTION: Machine configuration for iWave iW-RainboW-G37M-i.MX8M Nano SODIMM Board
#@MAINTAINER: iWave Systems Technologies Pvt. Ltd.

MACHINEOVERRIDES =. "mx8:mx8m:mx8mn:"

require conf/machine/include/imx-base.inc
require conf/machine/include/tune-cortexa53.inc

MACHINE_FEATURES += " wifi bluetooth optee bcm43455 bcm4356 bcm4359 jailhouse"

PREFERRED_PROVIDER_virtual/bootloader_mx8 = "u-boot-iwg"
PREFERRED_PROVIDER_virtual/kernel_mx8 = "linux-iwg"

# Device tree for i.MX8MN IWG37M
KERNEL_DEVICETREE = "freescale/imx8mn-iwg37d_2gb.dtb"

UBOOT_CONFIG ??= "sd"
UBOOT_CONFIG[sd] = "imx8mn_iwg37m_2gb_defconfig,sdcard"
SPL_BINARY = "spl/u-boot-spl.bin"

# Set DDR FIRMWARE
DDR_FIRMWARE_NAME = "lpddr4_pmu_train_1d_imem.bin lpddr4_pmu_train_1d_dmem.bin lpddr4_pmu_train_2d_imem.bin lpddr4_pmu_train_2d_dmem.bin"

# Set u-boot DTB
UBOOT_DTB_NAME = "imx8mn-iwg37m.dtb"

IMAGE_INSTALL_append = " iwtest obexftp dhcpcd dnsmasq gstreamer1.0-libav ffmpeg x264 "
CORE_IMAGE_EXTRA_INSTALL += "gstreamer1.0-plugins-ugly-meta packagegroup-fsl-gstreamer1.0-commercial"
CORE_IMAGE_EXTRA_INSTALL += "gstreamer1.0-plugins-ugly"
LICENSE_FLAGS_WHITELIST = "commercial"

# Set imx-mkimage boot target
IMXBOOT_TARGETS = "flash_iwg37m"

SERIAL_CONSOLES = "115200;ttymxc3"

IMAGE_BOOTLOADER = "imx-boot"

BOOT_SPACE = "65536"

LOADADDR = ""
UBOOT_SUFFIX = "bin"
UBOOT_MAKE_TARGET = ""
IMX_BOOT_SEEK = "32"
```

## conf/machine/imx8mn-iwg37m.conf
```bitbake
#@TYPE: Machine
#@NAME: iWave iW-RainboW-G37M-i.MX8M Nano SODIMM Development Kit
#@DESCRIPTION: Machine configuration for iWave iW-RainboW-G37M-i.MX8M Nano SODIMM Board
#@MAINTAINER: iWave Systems Technologies Pvt. Ltd.

MACHINEOVERRIDES =. "mx8:mx8m:mx8mn:"

require conf/machine/include/imx-base.inc
require conf/machine/include/tune-cortexa53.inc

MACHINE_FEATURES += " wifi bluetooth optee bcm43455 bcm4356 bcm4359 jailhouse"

PREFERRED_PROVIDER_virtual/bootloader_mx8 = "u-boot-iwg"
PREFERRED_PROVIDER_virtual/kernel_mx8 = "linux-iwg"

# Device tree for i.MX8MN IWG37M
KERNEL_DEVICETREE = "freescale/imx8mn-iwg37d.dtb"

WKS_FILE_DEPENDS_append = " imx-m7-demos"
IMAGE_BOOT_FILES += "imx8mn_m7_TCM_hello_world.bin \
                    imx8mn_m7_TCM_rpmsg_lite_pingpong_rtos_linux_remote.bin \
                    imx8mn_m7_TCM_rpmsg_lite_str_echo_rtos.bin \
"

UBOOT_CONFIG ??= "sd"
UBOOT_CONFIG[sd] = "imx8mn_iwg37m_defconfig,sdcard"
SPL_BINARY = "spl/u-boot-spl.bin"

# Set DDR FIRMWARE
DDR_FIRMWARE_NAME = "lpddr4_pmu_train_1d_imem.bin lpddr4_pmu_train_1d_dmem.bin lpddr4_pmu_train_2d_imem.bin lpddr4_pmu_train_2d_dmem.bin"

# Set u-boot DTB
UBOOT_DTB_NAME = "imx8mn-iwg37m.dtb"

IMAGE_INSTALL_append = " iwtest obexftp dhcpcd dnsmasq gstreamer1.0-libav ffmpeg x264 "
CORE_IMAGE_EXTRA_INSTALL += "gstreamer1.0-plugins-ugly-meta packagegroup-fsl-gstreamer1.0-commercial"
CORE_IMAGE_EXTRA_INSTALL += "gstreamer1.0-plugins-ugly"
LICENSE_FLAGS_WHITELIST = "commercial"

# Set imx-mkimage boot target
IMXBOOT_TARGETS = "flash_iwg37m"

SERIAL_CONSOLES = "115200;ttymxc3"

IMAGE_BOOTLOADER = "imx-boot"

BOOT_SPACE = "65536"

LOADADDR = ""
UBOOT_SUFFIX = "bin"
UBOOT_MAKE_TARGET = ""
IMX_BOOT_SEEK = "32"
```
